## drivers/soc/oplus/Kconfig
```kconfig
source "drivers/soc/oplus/system/Kconfig"
#endif /* VENDOR_EDIT */

#ifdef OPLUS_FEATURE_LOWMEM_DBG
source "drivers/soc/oplus/lowmem_dbg/Kconfig"
##endif /* OPLUS_FEATURE_LOWMEM_DBG */

#ifdef OPLUS_FEATURE_MEMLEAK_DETECT
#Add for svelte
source "drivers/soc/oplus/svelte/Kconfig"
#endif /* OPLUS_FEATURE_MEMLEAK_DETECT */
```

## drivers/soc/oplus/system/oppo_gpio/Kconfig
```kconfig
#change 'y' to 'n', if you want fo close this controller
config OPLUS_OPPO_GPIO
    bool "oppo gpio controller"
    default n
    help
      define this config to control oppo gpio.
```

## drivers/soc/oplus/system/oppo_saupwk/Kconfig
```kconfig
# SPDX-License-Identifier: GPL-2.0-only
# Copyright (C) 2018-2020 Oplus. All rights reserved.
#change 'y' to 'n', if you want fo close saupwk feature
config OPLUS_FEATURE_SAUPWK
    tristate "oppo saupwk project"
    default n
    help
      define this config to init oppo saupwk.
```

## drivers/soc/oppo/oppo_healthinfo/Kconfig
```kconfig
#ifdef OPLUS_FEATURE_HEALTHINFO
config OPPO_HEALTHINFO
bool "config oppo healthinfo"
help
    define this config to init oppo healthinfo.
config CAMERA_OPT
	bool "config camera opt"
	default n
	help
	  reduce camera provider task runnable time
config MMAP_LOCK_OPT
	bool "config mmap lock opt boos"
	default n
	help
	  reduce sleep time in mmap lock
#endif /* OPLUS_FEATURE_HEALTHINFO */
```
